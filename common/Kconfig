## common/Kconfig
```kconfig
# Copyright (c) 2026 Vinicius Pedrosa
# SPDX-License-Identifier: MIT OR Apache-2.0

menu "Gate Link radio"

module = GATE_RADIO
module-str = gate_radio
source "subsys/logging/Kconfig.template.log_config"

config GATE_RADIO_FREQUENCY_HZ
	int "LoRa carrier frequency in Hz"
	default 915000000
	help
	  Carrier frequency used by the point-to-point LoRa link. Keep this
	  centralized so the applications do not embed regional or module
	  assumptions in their state machines.

config GATE_RADIO_BANDWIDTH_KHZ
	int "LoRa signal bandwidth in kHz"
	default 125
	range 125 500
	help
	  Supported values are 125, 250 and 500 kHz.

config GATE_RADIO_SPREADING_FACTOR
	int "LoRa spreading factor"
	default 10
	range 6 12

config GATE_RADIO_CODING_RATE_DENOMINATOR
	int "LoRa coding rate denominator"
	default 5
	range 5 8
	help
	  A value of 5 means coding rate 4/5, 6 means 4/6, and so on.

config GATE_RADIO_PREAMBLE_LEN
	int "LoRa preamble length"
	default 8
	range 6 65535

config GATE_RADIO_TX_POWER_DBM
	int "LoRa TX power in dBm"
	default 10
	range -9 20
	help
	  Keep conservative during bench tests. Final value depends on module,
	  antenna, range tests, and local regulation.

config GATE_RADIO_PUBLIC_NETWORK
	bool "Use LoRa public network sync word"
	default n
	help
	  Keep disabled for this private point-to-point link.

config GATE_RADIO_RECOVERY_THRESHOLD
	int "Consecutive radio failures before a recovery attempt"
	default 3
	range 1 20
	help
	  How many consecutive receiver radio errors are tolerated before the
	  receiver re-probes the module and reprograms the modem.

	  The transmitter does not use this threshold for runtime command
	  handling. Once a command reaches the transmitter state machine boundary,
	  a local radio error triggers recovery on the same button cycle.

	  Waiting for a peer that never answers is not a radio error and never
	  counts toward this threshold: a command that exhausts its retries means
	  the link failed, not that the local radio did.

config GATE_RADIO_RECOVERY_INTERVAL_MS
	int "Delay between radio recovery attempts in milliseconds"
	default 5000
	range 100 60000
	help
	  Paces recovery so a module that is unpowered, unwired, or wedged does
	  not turn the application into a busy loop. The same interval paces the
	  retries done at boot when the radio does not answer.

endmenu

menu "Gate Link authentication"

config GATE_AUTH
	bool
	default y
	select MBEDTLS
	select MBEDTLS_MD
	select MBEDTLS_SHA256

config GATE_AUTH_KEY_HEX
	string "Shared authentication key as 64 hex characters"
	default ""
	depends on GATE_AUTH
	help
	  Shared 256-bit key used to authenticate COMMAND and ACK packets with
	  HMAC-SHA256. Leave the repository default empty: real keys must be
	  provisioned through local, unversioned build configuration.

	  The key is never transmitted over LoRa. Do not reuse the same key for
	  unrelated projects or installed devices.

config GATE_COUNTER_STORE_NVS
	bool "Persist replay counters in Zephyr NVS"
	depends on NVS && FLASH_MAP && FLASH_PAGE_LAYOUT
	help
	  Store the transmitter's last issued sequence and the receiver's last
	  accepted sequence in the board's storage partition. This is required
	  for replay resistance across device resets.

config GATE_COUNTER_NVS_SECTOR_COUNT
	int "Number of NVS sectors used for Gate Link counters"
	default 3
	range 2 8
	depends on GATE_COUNTER_STORE_NVS
	help
	  Number of flash sectors dedicated to the small monotonic counters.
	  The ESP32 DevKitC board definition exposes a 24 KiB storage
	  partition, so three 4 KiB sectors leave room for NVS metadata and
	  rotation.

endmenu
```

## tests/sequence/testcase.yaml
```yaml
# Copyright (c) 2026 Vinicius Pedrosa
# SPDX-License-Identifier: MIT OR Apache-2.0

common:
  tags:
    - sequence
  platform_allow:
    - native_sim/native/64
  integration_platforms:
    - native_sim/native/64

tests:
  gate_link.sequence: {}
```
